## basicstation/Config.in
```kconfig
# basicstation gateway platform configuration

if PACKAGE_basicstation

config GATEWAY_PLATFORM
	string "Gateway Platfrom: linux linuxpico and corecell"
	default linux

endif
```

## lora-gateway-hal/Config.in
```kconfig
# lora-gateway-hal configuration

if PACKAGE_lora-gateway-hal

config SX1301_SPI_PATH
	string "SPI Dev Path"
	default /dev/spidev0.0

config SX1301_SPI_SPEED
	string "SPI Speed (Hz)"
	default 8000000

endif
```

## lora-gateway/Config.in
```kconfig
# libloragw configuration

if PACKAGE_libloragw

config SX1301_SPI_PATH
	string "SPI Dev Path"
	default /dev/spidev0.0

endif
```
